## esp-idf/Kconfig
```kconfig
menu "spangap: spangap-core"

config SPANGAP_PROJECT_NAME
    string "Project name (immutable identity)"
    default "spangap"
    help
        Compile-time project identity. Stored verbatim in s.sys.project at
        first boot. On every subsequent boot, spangapInit() compares the
        loaded value to this string and factory-resets /state if they
        differ — so flashing a different spangap project (e.g. seccam →
        reticulous) over the same flash chip starts with a clean state.

        Not user-editable at runtime. For the user-facing display name,
        use SPANGAP_FW_NAME (fw.name) instead.

# ── Firmware identity (fw.*) ──────────────────────────────────────────────
# Immutable, compile-time. These define WHAT is running (not what it's running
# ON — that's the mutable hostname below). Set from straddle.yaml's stub /
# display_name / banner root keys (desugared to these by spangap-inside), and
# exposed read-only to the browser as the fw.* subtree synthesized into the
# storage dump — never persisted, never patchable, `set fw.* ...` errors.

config SPANGAP_FW_STUB
    string "Firmware stub name (lowercase id)"
    default "spangap"
    help
        Short lowercase identity, e.g. "reticulous". Exposed as fw.stub.
        Reserved as the future state-directory prefix so multiple firmwares'
        state can coexist on one SD card. Set via straddle.yaml `stub:`.

config SPANGAP_FW_NAME
    string "Firmware proper name (menu title)"
    default "spangap"
    help
        User-facing proper name shown in the leftmost menu, e.g. "Reticulous"
        (usually the stub, capitalized). Exposed as fw.name. Immutable. Set via
        straddle.yaml `display_name:`.

config SPANGAP_FW_BANNER
    string "Firmware banner / slogan"
    default "spangap device"
    help
        One-line description, slogan or motto, e.g. "Reticulum mesh networking
        for the masses!". Exposed as fw.banner. Immutable. Set via
        straddle.yaml `banner:`.

config SPANGAP_FW_HOSTNAME
    string "Default hostname"
    default "spangap"
    help
        Compile-time DEFAULT for the MUTABLE s.net.hostname (seeded on first
        boot, user-editable thereafter, and the base for the AP SSID). Unlike
        the fw.* identity above this is what the device is running ON, so it is
        settable. Set via straddle.yaml `default_hostname:`.

config SPANGAP_SDCARD
    bool "Mount SD card on boot"
    default n
    help
        When enabled, spangapInit() calls fs_mount_sd(). Required for any
        module that writes to /sdcard (recordings, log files on SD, etc.).
        Pick the bus type below; pins are board-specific — set them in
        your project's sdkconfig.defaults.

choice SPANGAP_SDCARD_BUS
    prompt "SD card bus"
    depends on SPANGAP_SDCARD
    default SPANGAP_SDCARD_BUS_SDMMC
    help
        SDMMC uses the ESP32-S3's dedicated SDIO peripheral (faster,
        dedicated pins). SPI uses the shared SPI bus via spi_helper —
        right choice for boards like T-Deck Plus where the SD slot
        shares SCK/MOSI/MISO with display + LoRa.

    config SPANGAP_SDCARD_BUS_SDMMC
        bool "SDMMC (dedicated SDIO peripheral)"
    config SPANGAP_SDCARD_BUS_SPI
        bool "SPI (shared SPI bus via spi_helper)"
endchoice

# ── SDMMC variant pins ──

config SPANGAP_SDCARD_PIN_CLK
    int "SDMMC CLK pin"
    depends on SPANGAP_SDCARD_BUS_SDMMC

config SPANGAP_SDCARD_PIN_CMD
    int "SDMMC CMD pin"
    depends on SPANGAP_SDCARD_BUS_SDMMC

config SPANGAP_SDCARD_PIN_D0
    int "SDMMC D0 pin"
    depends on SPANGAP_SDCARD_BUS_SDMMC

config SPANGAP_SDCARD_4BIT
    bool "4-bit SDMMC bus (D0..D3 wired)"
    depends on SPANGAP_SDCARD_BUS_SDMMC
    default n
    help
        Enable when the board has all four data lines (D0..D3) routed.
        Roughly 4× throughput over 1-bit. Most ESP32-S3 dev boards (XIAO
        Sense included) only expose D0; leave off unless you know the
        SD slot has the wider bus.

config SPANGAP_SDCARD_PIN_D1
    int "SDMMC D1 pin"
    depends on SPANGAP_SDCARD_4BIT

config SPANGAP_SDCARD_PIN_D2
    int "SDMMC D2 pin"
    depends on SPANGAP_SDCARD_4BIT

config SPANGAP_SDCARD_PIN_D3
    int "SDMMC D3 pin"
    depends on SPANGAP_SDCARD_4BIT

# ── SPI variant pins ──

config SPANGAP_SDCARD_SPI_HOST
    int "SPI host (2 = SPI2/FSPI, 3 = SPI3/HSPI)"
    depends on SPANGAP_SDCARD_BUS_SPI
    range 2 3
    default 2
    help
        Which SPI peripheral the SD card sits on. Must match the host
        any other driver on the same bus (e.g. the LoRa transport in
        reticulous) initialises via spi_helper.

config SPANGAP_SDCARD_SPI_PIN_CS
    int "SPI SD CS pin"
    depends on SPANGAP_SDCARD_BUS_SPI

config SPANGAP_SDCARD_SPI_PIN_SCK
    int "SPI SCK pin (shared bus)"
    depends on SPANGAP_SDCARD_BUS_SPI

config SPANGAP_SDCARD_SPI_PIN_MOSI
    int "SPI MOSI pin (shared bus)"
    depends on SPANGAP_SDCARD_BUS_SPI

config SPANGAP_SDCARD_SPI_PIN_MISO
    int "SPI MISO pin (shared bus)"
    depends on SPANGAP_SDCARD_BUS_SPI

config SPANGAP_SDCARD_SPI_FREQ_KHZ
    int "SPI SD clock (kHz)"
    depends on SPANGAP_SDCARD_BUS_SPI
    range 400 40000
    default 20000
    help
        Bus clock used after card init. SD spec allows up to 25 MHz in
        SPI mode; many cards happily run at 40 MHz with short wiring,
        but 20 MHz is a safe default on shared-bus boards.

config SPANGAP_SDCARD_MAX_FILES
    int "Max files open at once on the SD card"
    depends on SPANGAP_SDCARD
    range 1 20
    default 6
    help
        Upper bound on simultaneously-open files on the FAT/SD volume.
        FATFS pre-allocates one sector cache per slot at mount, so each
        unit of this count costs FF_MAX_SS bytes of RAM up front (512 B
        with CONFIG_WL_SECTOR_SIZE_512, which spangap-core sets by default
        since it uses LittleFS — not FAT — on internal flash). 6 covers
        the platform's own users (log stream, fs read/write streams, cron
        logfile) with headroom; raise it if your app opens many SD files
        concurrently, lower it to reclaim RAM.

config SPANGAP_SDCARD_ALLOC_KB
    int "SD format allocation unit (KB)"
    depends on SPANGAP_SDCARD
    range 1 128
    default 8
    help
        FAT cluster size (KB) used whenever the firmware formats the SD card
        (fsFormatSd, and the format-on-mount-fail path). Only affects formats
        the device performs — a card formatted on a computer keeps its own
        cluster size. Each file rounds up to a whole cluster, so large clusters
        waste space with many small files: a tree of ~7 KB map tiles on a
        64 KB-cluster card uses ~9x its real size. 8 KB ≈ one cluster per tile
        (near-zero waste) while keeping the FAT small enough to mount quickly on
        large cards; raise it for fewer/larger files, lower it to trim waste
        further at the cost of a bigger FAT.

config SPANGAP_MAX_FIRMWARE_KB
    int "Maximum firmware size / state floor (KB, 0 = fill the flash container)"
    default 0
    help
        The largest the firmware (nvs + app + fixed, plus the updater slot when
        present) may occupy, in KB — equivalently, the flash offset where the
        runtime read-write /state partition BEGINS. `state` then fills everything
        from here to the end of the real chip (discovered at boot via SFDP), so a
        bigger part yields a bigger /state automatically, with no rebuild.

        This is byte-granular and INDEPENDENT of CONFIG_ESPTOOLPY_FLASHSIZE (the
        power-of-two flash container / bootloader-header size). It is expressed in
        the partition table as a trailing `reserved` partition, so nothing is
        baked into the app: statePartitionEnsure() in fs.cpp reads the floor back
        as the top of the on-flash table.

        Must be >= the shipped firmware (the build errors otherwise) and <=
        CONFIG_ESPTOOLPY_FLASHSIZE. 0 defaults the floor to the whole container
        (state starts at the flash top). CHANGING THIS RELOCATES /state: existing
        devices factory-reset on the next boot (the moved partition fails to mount
        and reformats), so warn users before bumping it.

config SPANGAP_ITS_INBOX_DEPTH
    int "ITS mailbox depth (messages)"
    range 8 1024
    default 32
    help
        Default depth, in messages, of each ITS task's mailbox (the per-task
        FreeRTOS queue carrying connect/disconnect/aux/forward signaling).
        Slots are now single pointers (~4 B each) to heap-allocated messages,
        so depth is nearly free — the default rises from the old 8. Per-task
        overrides pass a non-zero inboxDepth to itsServerInit/itsClientInit.

config SPANGAP_ITS_INBOX_MSG_MAX
    int "ITS mailbox per-message payload guard (bytes)"
    range 320 65536
    default 4096
    help
        Default upper bound on a single mailbox message's payload (connect
        handshake, aux message, forward data). Oversized sends are rejected,
        never truncated. The effective guard is floored at ITS_MAX_MSG_DATA
        (320) so small-guard tasks never regress. Per-task override:
        itsServerInit's inboxMaxMsgLen argument (0 = this default). Payload
        memory is borrowed per-message and freed on read, so a generous guard
        costs nothing at idle.

config SPANGAP_ITS_PKT_DEPTH
    int "ITS packet-link descriptor depth (messages per direction)"
    range 2 256
    default 16
    help
        Default number of in-flight whole messages a packet-link direction can
        queue (the descriptor ring depth). Each slot is an 8-byte descriptor;
        the message payloads are separate heap blocks borrowed per message and
        freed on read. Per-port override: the `depth` argument to
        itsServerPortOpen (0 = this default).

config SPANGAP_ITS_MSG_MAX
    int "ITS packet-link per-message size guard (bytes)"
    range 256 262144
    default 65536
    help
        Default largest single message a packet link accepts — the size guard,
        NOT the backpressure window (that is the per-direction byte cap passed
        to itsServerPortOpen). itsRecvBufSize/itsSendBufSize report this on a
        packet link, so routers size their shared receive buffer from it.
        Per-port override: the `maxMsg` argument to itsServerPortOpen
        (0 = this default).

config SPANGAP_STORAGE_OP_TIMEOUT_MS
    int "Storage sync-write wait bound (ms)"
    range 500 60000
    default 5000
    help
        How long a public storage write (storageSet and friends) waits for the
        storage actor task to apply its op message before warning and giving up
        (D1). Same "can't realistically happen" class as the old write mutex
        never being released. Writes are synchronous so read-your-writes holds:
        every storageSet(k,v); … storageGetInt(k) sequence keeps working. When
        the caller IS the storage task, or storage hasn't spawned yet, the write
        applies directly and this bound does not apply.

config SPANGAP_STORAGE_NOTIFY_TIMEOUT_MS
    int "Storage change-notification send bound (ms)"
    range 1 1000
    default 10
    help
        How long the storage actor blocks delivering one CHANGED message to a
        remote subscriber's mailbox before warning and dropping it (D2). Bounded
        so a subscriber stuck in a sync write can never deadlock the actor.
        Pointer-slot mailboxes make depth nearly free, so the drop backstop is
        unreachable in practice; the storage task's own subscriptions are
        invoked directly (no message), avoiding self-send entirely.

config SPANGAP_STORAGE_NOTIFY_INBOX
    int "Storage change-notification inbox depth"
    range 64 1024
    default 256
    help
        Depth of the storage task's inbox (a PSRAM-backed ITS queue carrying op
        messages and change self-sends). Slots are now single pointers (~4 B),
        so depth is cheap. A ~1 Hz stats publish from many producers lands a
        burst of writes; this sizes the actor's op backlog.

config SPANGAP_STORAGE_OP_MSG_MAX
    int "Storage op message size guard (bytes)"
    range 65536 524288
    default 196608
    help
        Per-message payload guard on the storage task's inbox: the largest
        single op a foreign task can send (a big storageSet value, or a
        storageSetTree/storageCopy subtree serialized as one message). Owned
        ops hand over a heap pointer, so a large guard costs nothing when
        idle — it only bounds what producers may send. Must comfortably
        exceed the largest single value any producer publishes; today that
        is a Nomad page body (NOMAD_MAX_PAGE_PUBLISH, 128 KB) plus op
        overhead.

config SPANGAP_HEAP_INTEGRITY_POLL
    bool "Periodically check internal-heap integrity (debug)"
    default n
    help
        Diagnostic only — leave OFF for shipping builds (real CPU/throughput
        cost). The log task calls heap_caps_check_integrity(MALLOC_CAP_INTERNAL,
        true) once per SPANGAP_HEAP_INTEGRITY_POLL_MS, aborting at the first
        corrupted block and naming the region — so a silent stray write /
        use-after-free into internal DRAM (e.g. clobbering a FreeRTOS list /
        ringbuffer semaphore, or a notify into a freed TCB) faults at, or near,
        the bad write instead of much later in unrelated code.

        For the full hunt also enable, via menuconfig (kconfiglib can't `select`
        a choice option, so these can't be bundled here):
          * Component config → Heap memory debugging → Heap corruption detection
            → "Comprehensive"  (HEAP_POISONING_COMPREHENSIVE) — adds the head/tail
            canaries + free-fill this poll inspects.
          * Component config → FreeRTOS → Check for stack overflow → "Check using
            canary + PTRVAL"  (FREERTOS_CHECK_STACKOVERFLOW_PTRVAL).
        Pair with SPANGAP_WATCH_ADDR to catch the writer's backtrace once the poll
        reports an address.

config SPANGAP_HEAP_INTEGRITY_POLL_MS
    int "Internal-heap integrity check interval (ms)"
    depends on SPANGAP_HEAP_INTEGRITY_POLL
    range 200 60000
    default 1000
    help
        How often the log task runs the internal-heap integrity check. Lower
        narrows the window between the corrupting write and the abort (better
        backtrace locality) at higher CPU cost; the default 1 Hz matches the
        log task's existing pmPollUsb cadence.

config SPANGAP_WATCH_ADDR
    hex "Arm a HW store-watchpoint at this address (debug; 0 = off)"
    default 0x0
    help
        Diagnostic only. When non-zero, the log task arms a hardware STORE
        watchpoint covering a 16-byte window around this address, on BOTH
        cores, early at boot. The next instruction that writes anywhere in
        that window faults immediately — so a use-after-free writer (located
        via SPANGAP_HEAP_INTEGRITY_POLL's `CORRUPT HEAP: ... at 0xADDR` line)
        panics with its own backtrace instead of corrupting silently.

        Workflow: read the address from a CORRUPT HEAP log line, set it here,
        reflash. The window is aligned down to 16 bytes, so two corrupted
        words a few bytes apart are both covered by one watchpoint. Assumes
        the address is stable across boots (boot-time allocation order is
        deterministic; confirm by checking the address survives a reboot).
        Uses watchpoint slot 1 (slot 0 left for IDF/panic/gdbstub).

## CONFIG_SPANGAP_LCD / _WEB / _OTA / _WG / _UPNP / _DUCKDNS / _ACME lived here
## until each became its own straddle. They are now auto-generated presence
## symbols emitted by spangap-inside into the synthetic `_spangap_present`
## component's Kconfig.projbuild whenever the corresponding straddle is staged
## (driven by the buildable's requires: / optional_requires: plus any
## --with <name> and minus any --without / --no-X). Source code keeps the same
## CONFIG_SPANGAP_<NAME> spelling — they're shortcut aliases of the generic
## CONFIG_STRADDLE_<NAME> symbol. See spangap/INTERNALS.md.

endmenu

# The vendored esp_wireguard tuning menu ("WireGuard (vendored fork —
# internal)", visible if SPANGAP_WG) moved to wg/esp-idf/Kconfig in Phase 2
# of the straddles plan. The SPANGAP_WG toggle above stays here because
# spangapInit()'s conditional wgInit() call and spangap.h's conditional
# `#include "wg.h"` reference it — once those move into a generated
# straddle dispatcher, SPANGAP_WG (and its siblings UPNP/DUCKDNS/ACME/OTA/LCD)
# move out alongside the code that reads them.
```
