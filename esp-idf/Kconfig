## esp-idf/sdkconfig.defaults.spangap
```kconfig
# spangap-mandated sdkconfig defaults — settings the spangap-core platform
# needs at the values set here. Layered before the consumer's
# sdkconfig.defaults by spangap-core/cmake/bootstrap.cmake. Consumer values
# override on collision.
#
# Anything that is purely consumer-specific (camera sensor support, app-level
# protocol tuning, board-specific pin assignments, etc.) belongs in the
# consumer's own sdkconfig.defaults — not here.

# WiFi — don't let the WiFi blob cache SSID/BSSID/channel in NVS. Two reasons:
# (1) silent auto-reconnect via cached state would bypass net.cpp's connection
# management. (2) avoids mid-session NVS writes from the radio firmware that
# can disrupt active traffic. PHY-cal NVS writes at boot are unaffected.
CONFIG_ESP_WIFI_NVS_ENABLED=n

# lwIP — enough sockets for HTTP/HTTPS/WS + outbound clients. 24 is comfortable
# for the spangap web stack; raise if a consumer adds many more listeners.
CONFIG_LWIP_MAX_SOCKETS=24

# lwIP — TCP send/recv windows + reuse + oversize MSS for high-throughput TCP
# (RTSP, WebDAV, log/cli streaming). Defaults are too small for anything
# beyond config bytes.
CONFIG_LWIP_TCP_SND_BUF_DEFAULT=16384
CONFIG_LWIP_TCP_WND_DEFAULT=16384
CONFIG_LWIP_SO_REUSE=y
CONFIG_LWIP_TCP_OVERSIZE_MSS=y
CONFIG_LWIP_IRAM_OPTIMIZATION=y

# lwIP — PPP support (workaround for ESP-IDF 5.x netif->state conflict with WireGuard)
CONFIG_LWIP_PPP_SUPPORT=y

# WiFi TX — larger BA window + more dynamic TX buffers for bursty video
CONFIG_ESP_WIFI_TX_BA_WIN=32
CONFIG_ESP_WIFI_DYNAMIC_TX_BUFFER_NUM=64
# NOTE: do NOT enable CONFIG_SPIRAM_TRY_ALLOCATE_WIFI_LWIP here as a blanket
# default. On display boards (T-Deck) the LCD/LVGL already claim the internal
# DMA pool, and moving WiFi/lwIP toward PSRAM tips the WiFi *static* RX buffers
# (16 × ~1.6 KB, internal-DMA-only — cannot move to PSRAM) over the edge:
# "malloc buffer fail / Expected to init 16 rx buffer, actual is 12" → WiFi
# never inits. The display-less seeed board has the internal headroom and sets
# it per-board. The SD-bounce 0x101 it would have papered over is fixed at the
# source instead (SD-on-SPI skips the bounce — see spangap-core CMakeLists).

# PSRAM — present on every target.
# Mode (octal vs quad) is board hardware, so each board sets it in its own
# sdkconfig.defaults (T-Deck S3R8 = octal, Heltec V4 S3R2 = quad) — NOT here.
# 80 MHz is a sane default both current boards use; a board may override.
CONFIG_SPIRAM=y
CONFIG_SPIRAM_SPEED_80M=y
# Malloc placement: 0 = every untagged allocation goes to PSRAM. Internal DRAM
# is the scarce resource here (~73 KB free, and WiFi's static RX wants ~25 KB of
# DMA-capable internal RAM), so we keep the default at PSRAM and pin ONLY the few
# things that MUST be internal — ISR/critical-section control structures (driver
# ring buffers, queues) — with explicit MALLOC_CAP_INTERNAL at their call sites
# (ITS inbox/streams, USB-JTAG ring). Tested the inverse (=16384, internal-pref):
# it pulled ~28 KB into DRAM — almost all of it PSRAM-safe UI/buffer data (LVGL,
# CLI) — and dropped DMA-lowest to 19 KB *with WiFi off*, which won't survive WiFi
# on. So: PSRAM-default + surgical internal pins, not internal-default.
CONFIG_SPIRAM_MALLOC_ALWAYSINTERNAL=0
# Reserve internal DRAM for DMA-capable allocations. Consumers that can ONLY
# live in internal DMA RAM and all peak together at boot: WiFi static RX
# (16 × ~1.6 KB), mbedTLS/lwIP, and — the one that bites — IDF's spi_master
# bounce for SD-on-SPI *reads*. Every single-sector SDSPI read transfers
# 512 B + 2 CRC = 514 B, which is not 4-byte aligned, so spi_master allocates a
# fresh ~516 B internal-DMA temp buffer per read (esp_driver_spi
# setup_dma_priv_buffer). At the boot peak (WiFi scan + LCD + LoRa + LXMF
# opening an SD file) the 48 KB reserve was occasionally exhausted, that tiny
# alloc returned NULL, and IDF's cleanup path NULL-derefs (memcpy from a
# never-assigned buffer_to_rcv) → boot-loop. It was a race: most boots lost,
# one eventually won. 64 KB gives the headroom so the read-bounce can't fail.
# (This is a *read*-path sibling of the SD-write 0x101 fix; writes were staged
# aligned, reads go through IDF's own block_buf and can't be pre-aligned here.)
CONFIG_SPIRAM_MALLOC_RESERVE_INTERNAL=65536

# Per-task heap ownership tracking (for heapDump on malloc failures)
CONFIG_HEAP_TASK_TRACKING=y

# ─── DEBUG — internal-DRAM corruption hunt (TEMPORARY; revert before shipping) ───
# Chasing a silent stray write into internal RAM: it clobbers a FreeRTOS
# list / ringbuffer recv-semaphore and only surfaces much later as an
# `xTaskRemoveFromEventList ... (pxUnblockedTCB)` assert from the USB-Serial-JTAG
# RX ISR. These trip the fault at (or near) the bad write instead.
#   * COMPREHENSIVE poisoning adds head/tail canaries + free-fill so an overrun
#     into a neighbouring block is detectable; pair with the runtime
#     SPANGAP_HEAP_INTEGRITY_POLL (off by default) which scans for tripped
#     canaries once per second on the log task.
#   * PTRVAL stack-overflow check (mode 2) is stricter than the default
#     context-switch canary — it validates the stack pointer on every switch.
# Both carry a runtime/throughput cost; remove this block (reverting to the
# implicit HEAP_POISONING_DISABLED / CHECK_STACKOVERFLOW_CANARY) once the
# offending writer is found.
CONFIG_HEAP_POISONING_COMPREHENSIVE=y
CONFIG_FREERTOS_CHECK_STACKOVERFLOW_PTRVAL=y
# Runtime scan enabled for this hunt (the whole block reverts together).
CONFIG_SPANGAP_HEAP_INTEGRITY_POLL=y
# HW store-watchpoint (0 = off). It confirmed the victim was main_task's freed
# TCB but can't sit on a live TCB during boot (that address is reused), so it's
# parked off; the integrity poll above verifies the fix (no more CORRUPT HEAP).
CONFIG_SPANGAP_WATCH_ADDR=0x0
# ─────────────────────────────────────────────────────────────────────────────

# IPC task stack — IDF default 1280 B is enough for the bare IPC service but not
# for cross-core init callbacks: the LittleFS init path that runs on ipc0 during
# spangap_init has been seen to overflow 1280 B. 4 KiB gives comfortable room.
CONFIG_ESP_IPC_TASK_STACK_SIZE=4096

# Idle task stack — SMP idle runs deferred-free hooks that can overflow the
# 1536 B default.
CONFIG_FREERTOS_IDLE_TASK_STACKSIZE=2048

# IPv6 SLAAC — form a global address from router RAs so devices reach v6-only
# hosts (the dial path is AF_UNSPEC). Platform-wide networking policy.
CONFIG_LWIP_IPV6_AUTOCONFIG=y

# Power management + tickless idle (required for automatic light sleep)
CONFIG_PM_ENABLE=y
CONFIG_PM_PROFILING=y
CONFIG_FREERTOS_USE_TICKLESS_IDLE=y

# FAT — long filenames (strftime patterns exceed 8.3).
# exFAT was removed from ESP-IDF 5.4 menuconfig — SD cards must be FAT32.
CONFIG_FATFS_LFN_HEAP=y
# FATFS sector size = 512 B (down from IDF's 4096 default). FF_MAX_SS is set
# from the FATFS_SECTOR_SIZE *choice* (NOT from CONFIG_WL_SECTOR_SIZE — that's
# the wear-levelling layer, and we have no WL partition: flash is LittleFS).
# Every per-file cache + the volume window is sized to FF_MAX_SS. IDF defaults
# this choice to 4096, which exists only to serve 4K-sector media / wear-
# levelled FAT-on-flash. Our SD card is physically 512 B and the allocation
# unit (SPANGAP_SDCARD_ALLOC_KB, the FAT cluster size) is independent of the
# sector size — 8 KB clusters are 16 × 512 B sectors, no 4096 sector needed.
# Dropping to 512 shrinks each per-file cache + the window 8× (~25 KB across
# max_files=6 + the volume) with no downside. See SPANGAP_SDCARD_MAX_FILES.
CONFIG_FATFS_SECTOR_512=y
# WL sector size is irrelevant here (no WL partition) but pin it to 512 too so
# nothing silently inherits the 4096 default if a WL-backed FAT is ever added.
CONFIG_WL_SECTOR_SIZE_512=y

# C++ — no exceptions or RTTI (not used)
CONFIG_COMPILER_CXX_EXCEPTIONS=n
CONFIG_COMPILER_CXX_RTTI=n

# Partition table — spangap generates partitions.csv at configure time from
# the OTA / app-percent / flash-size knobs (see scripts/gen-partitions.py).
CONFIG_PARTITION_TABLE_CUSTOM=y
CONFIG_PARTITION_TABLE_CUSTOM_FILENAME="partitions.csv"

# Default app-percent split (75% app / 25% fixed). Consumer can override in
# its own sdkconfig.defaults. OTA on/off is no longer a Kconfig knob — it's
# derived from whether spangap/ota is in the staged set (see bootstrap.cmake).
CONFIG_SPANGAP_APP_PERCENT=75

# FreeRTOS — task stats for 'top' command
CONFIG_FREERTOS_USE_TRACE_FACILITY=y
CONFIG_FREERTOS_GENERATE_RUN_TIME_STATS=y
CONFIG_FREERTOS_VTASKLIST_INCLUDE_COREID=y

# Per-task CPU boost (pm.cpp): slot 0 left for IDF, slot 1 (TLS_PM_BOOST) holds
# each boosted task's CPU_FREQ_MAX handle. Must be > TLS_PM_BOOST or pm.cpp #errors.
CONFIG_FREERTOS_THREAD_LOCAL_STORAGE_POINTERS=2

# Log — compile-time max level (runtime filtering via esp_log_level_set)
# Boot at INFO (quiet), compile VERBOSE so all levels work at runtime via "set log=..."
CONFIG_LOG_DEFAULT_LEVEL_INFO=y
CONFIG_LOG_MAXIMUM_LEVEL_VERBOSE=y
CONFIG_LOG_MAXIMUM_LEVEL_DEBUG=y

# Task watchdog — don't monitor IDLE1 (core 1 hosts heavy workers in spangap
# and most consumers).
CONFIG_ESP_TASK_WDT_CHECK_IDLE_TASK_CPU1=n

# Bootloader (RTC) watchdog — recover from a boot stall anywhere in init. Before
# the scheduler exists the task/int WDTs aren't running, so the RTC_WDT (a
# hardware timer in the RTC domain that fires regardless of CPU state) is the
# only thing that can break a hang. IDF's default disables it at
# init_disable_rtc_wdt (~1s in, the last SECONDARY sysinit) — which covers the
# octal-PSRAM @80MHz bring-up spin (esp_psram_impl_enable, marginal MSPI timing
# on the S3R8) but leaves the LATER window UNGUARDED: every straddle's hardware
# bring-up (LCD/touch/LoRa/SD I2C+SPI probes) runs after that point, and a stall
# there wedges forever (observed: sporadic dead hang, ~hourly during dev resets,
# nothing recovers it). DISABLE_IN_USER_CODE keeps the RTC_WDT armed across the
# WHOLE boot; spangapPostAppInit() disables it only once every init hook has run
# (see spangap_init.cpp) — past there the scheduler's WDTs take over. Timeout
# raised 3s→8s because the watched window now spans all synchronous init (SD
# mount + storageLoad + EC keygen + hardware probes ≈ a few seconds; everything
# network is async). Err generous: a too-short timeout would BOOT-LOOP a slow-
# but-healthy boot, which is worse than ~8s auto-recovery from a real (rare) hang.
CONFIG_BOOTLOADER_WDT_ENABLE=y
CONFIG_BOOTLOADER_WDT_DISABLE_IN_USER_CODE=y
CONFIG_BOOTLOADER_WDT_TIME_MS=8000

# Console over USB Serial JTAG (most spangap targets have no UART pins exposed)
CONFIG_ESP_CONSOLE_USB_SERIAL_JTAG=y
# IDF 5.5+: auto-hold a NO_LIGHT_SLEEP lock while USB host is connected.
# Without this, light sleep gates the USB clock → no SOF packets →
# usb_serial_jtag_is_connected() returns false → vfs_read/write start
# returning -1 → serial console dies. See esp-idf usb_serial_jtag_connection_monitor.c.
CONFIG_USJ_NO_AUTO_LS_ON_CONNECTION=y

# Main task stack — mbedTLS EC key generation needs ~10KB
CONFIG_ESP_MAIN_TASK_STACK_SIZE=16384

# Default 2304: WiFi + esp_netif + spangap's log path can overflow sys_evt on first connect
CONFIG_ESP_SYSTEM_EVENT_TASK_STACK_SIZE=8192

# mbedTLS — TLS server with EC P-256 self-signed cert generation
# CONFIG_MBEDTLS_SSL_PROTO_TLS1_3 is not set
CONFIG_MBEDTLS_TLS_SERVER=y
CONFIG_MBEDTLS_TLS_SERVER_AND_CLIENT=y
CONFIG_MBEDTLS_SERVER_SSL_SESSION_TICKETS=y
CONFIG_MBEDTLS_KEY_EXCHANGE_ECDHE_ECDSA=y
CONFIG_MBEDTLS_ECDSA_C=y
CONFIG_MBEDTLS_ECP_C=y
CONFIG_MBEDTLS_ECP_DP_SECP256R1_ENABLED=y
# PK_WRITE_C / X509_CRT_WRITE_C / X509_CREATE_C are unconditionally on in
# ESP-IDF 5.4's mbedtls port (no longer a menuconfig option).
CONFIG_MBEDTLS_EXTERNAL_MEM_ALLOC=y
# DTLS 1.2 (WebRTC DataChannel transport)
CONFIG_MBEDTLS_SSL_PROTO_DTLS=y
# ChaCha20-Poly1305 cipher suite — faster in software than AES-GCM on Xtensa
# (no table lookups, pure ARQ/add/rotate ops). Avoids the ESP32-S3 hardware
# AES-GCM DMA bug (espressif/esp-idf#12689) entirely.
CONFIG_MBEDTLS_CHACHA20_C=y
CONFIG_MBEDTLS_POLY1305_C=y
CONFIG_MBEDTLS_CHACHAPOLY_C=y
# Hardware AES off — spangap negotiates ChaCha20-Poly1305, no AES path is live.
# Also pre-empts the GCM DMA bug (#12689) from any future AES use.
CONFIG_MBEDTLS_HARDWARE_AES=n
CONFIG_MBEDTLS_SSL_MAX_CONTENT_LEN=16384
CONFIG_MBEDTLS_ASYMMETRIC_CONTENT_LEN=y
CONFIG_MBEDTLS_SSL_IN_CONTENT_LEN=16384
CONFIG_MBEDTLS_SSL_OUT_CONTENT_LEN=8192

# mDNS — task stack in PSRAM (allocations stay in DRAM for speed)
CONFIG_MDNS_TASK_CREATE_FROM_SPIRAM=y

# Flash — QIO mode (ESP32-S3). Size is board hardware: each board sets its own
# CONFIG_ESPTOOLPY_FLASHSIZE_* (both current boards are 16 MB), so no size here.
CONFIG_ESPTOOLPY_FLASHMODE_QIO=y

# Target
CONFIG_IDF_TARGET="esp32s3"
```
